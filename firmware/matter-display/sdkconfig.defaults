## firmware/thread-satellite/sdkconfig.defaults
```kconfig
CONFIG_IDF_TARGET="esp32h2"
CONFIG_ESP_MAIN_TASK_STACK_SIZE=4096
CONFIG_LOG_DEFAULT_LEVEL_INFO=y
CONFIG_FREERTOS_HZ=1000
CONFIG_OPENTHREAD_ENABLED=y
CONFIG_OPENTHREAD_END_DEVICE=y
```

## sdkconfig.defaults
```kconfig
# Default SDK configuration for AntyBrainFogur
CONFIG_ESP_MAIN_TASK_STACK_SIZE=4096
CONFIG_LOG_DEFAULT_LEVEL_INFO=y
CONFIG_FREERTOS_HZ=1000
```
